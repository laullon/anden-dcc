// Generated by tools/embed_web.py; edit web/ instead.
#pragma once

const char PAGE[] = R"WEB(<!doctype html>
<html lang="en">
<head>
<meta charset="utf-8"><meta name="viewport" content="width=device-width,initial-scale=1">
<meta name="theme-color" content="#142d32"><meta name="description" content="A small DCC controller for trains on display.">
<title>anden-dcc · Diorama control</title><link rel="icon" type="image/svg+xml" href="/icon.svg">
<style>
:root{color-scheme:light;--ink:#142d32;--muted:#647676;--paper:#f4f2eb;--white:#fffef9;--line:#d7dfd6;--mint:#a6d8c1;--orange:#ffb563;--red:#a34030;--mono:ui-monospace,SFMono-Regular,Consolas,monospace}*{box-sizing:border-box}body{margin:0;background:var(--paper);color:var(--ink);font-family:Inter,-apple-system,BlinkMacSystemFont,"Segoe UI",sans-serif;font-size:15px;line-height:1.5}button,input,select{font:inherit}button,summary,a{touch-action:manipulation}button,a,input,summary{outline-offset:5px}button{cursor:pointer}button:disabled{cursor:wait;opacity:.55}a{color:inherit;text-underline-offset:4px}svg{display:block}button svg{width:19px;height:19px}main{max-width:1160px;margin:auto;padding:32px 36px 26px}.topbar{display:flex;align-items:center;justify-content:space-between;gap:20px}.brand{display:flex;align-items:center;gap:13px;text-decoration:none}.brand img{width:52px;height:52px}.wordmark{font-size:25px;font-weight:800;letter-spacing:-1.1px;line-height:1.1}.wordmark span{font-weight:400;color:var(--muted)}.brand small{display:block;font-size:10px;letter-spacing:2px;margin-top:6px;text-transform:uppercase}.top-actions{display:flex;gap:16px;align-items:center}.connection{display:flex;align-items:center;gap:7px;font-size:12px}.dot{width:7px;height:7px;border-radius:50%;background:#b5bcb4;display:inline-block}.online .dot{background:#348a65}.language{display:flex;border:1px solid var(--line);border-radius:9px;padding:3px;background:var(--white)}.language button{border:0;background:none;border-radius:6px;font-size:11px;font-weight:700;padding:5px 8px;color:var(--muted)}.language button[aria-pressed=true]{background:var(--ink);color:white}.setup{margin-top:26px;border-block:1px solid var(--line)}.setup>summary{list-style:none;padding:13px 0;display:flex;align-items:center;justify-content:space-between;cursor:pointer;font-size:12px;font-weight:650}.setup>summary::-webkit-details-marker{display:none}.summary-label{display:flex;align-items:center;gap:8px}.summary-label svg{width:16px;height:16px}.setup>summary .plus{font-size:20px;font-weight:400;line-height:1}.setup[open]>summary .plus{transform:rotate(45deg)}.setup-content{padding:9px 0 26px;display:grid;grid-template-columns:1fr 1fr;gap:34px}.setup-panel{padding:22px;background:var(--white);border:1px solid var(--line);border-radius:14px}.setup-panel h2{font-size:17px;margin:0 0 8px}.setup-panel p{font-size:12px;color:var(--muted)}label{display:block;font-size:12px;font-weight:650;margin:16px 0 6px}input{border:1px solid var(--line);border-radius:8px;background:#fff;color:var(--ink);padding:10px 12px;width:100%;min-height:44px}input:focus{border-color:#437d65}.small-button{display:inline-flex;align-items:center;justify-content:center;gap:8px;background:var(--ink);color:white;border:1px solid var(--ink);padding:10px 14px;border-radius:8px;font-weight:650;font-size:12px;min-height:42px}.small-button.outline{background:none;color:var(--ink);border-color:var(--line)}.small-button.danger{color:var(--red);border-color:#dfb7ae;background:none}.form-actions{display:flex;gap:10px;flex-wrap:wrap;margin-top:18px}.field-note{display:block;color:var(--muted);font-size:11px;margin-top:5px}.notice{font-size:12px;min-height:18px;margin:12px 0 0}.notice.error{color:var(--red)}.network-links{font-family:var(--mono);font-size:11px;overflow-wrap:anywhere}.network-links a{display:block;margin:5px 0}progress{width:100%;accent-color:#437d65}.intro{display:flex;align-items:flex-end;justify-content:space-between;gap:22px;margin:38px 0 25px}.eyebrow{font-family:var(--mono);font-size:10px;letter-spacing:1.9px;text-transform:uppercase;color:var(--muted);margin:0 0 10px}.intro h1{font-size:clamp(30px,4.2vw,48px);line-height:1.1;letter-spacing:-2px;font-weight:650;margin:0}.intro-copy{margin:13px 0 0;color:var(--muted);font-size:14px}.mode-badge{border:1px solid #c7d4c7;border-radius:999px;padding:7px 12px;font-family:var(--mono);font-size:10px;white-space:nowrap;display:flex;align-items:center;gap:7px}.mode-badge .dot{background:#c08b44}.dashboard{display:grid;grid-template-columns:minmax(0,1.72fr) minmax(245px,1fr);gap:20px}.train-card{background:var(--ink);color:var(--white);border-radius:21px;overflow:hidden;position:relative;min-height:400px}.train-card .card-top{display:flex;align-items:center;justify-content:space-between;padding:24px 26px 0}.train-card .eyebrow{color:#9ab7b3;margin:0}.track-pill{font-family:var(--mono);font-size:10px;border:1px solid #446364;padding:5px 10px;border-radius:999px;color:#cce4dc}.train-art{height:178px;display:flex;align-items:center;justify-content:center;position:relative;overflow:hidden}.rails{position:absolute;left:0;right:0;bottom:25px;border-top:1px solid #345457;border-bottom:1px solid #345457;height:15px;background:repeating-linear-gradient(90deg,transparent 0 26px,#345457 27px 28px,transparent 29px 53px);transform:perspective(350px) rotateX(20deg)}.train-art>svg{height:135px;width:min(90%,380px);position:relative;z-index:1;filter:drop-shadow(0 12px 10px #07191b80)}.lamp{fill:#7e9b94;transition:fill .2s,filter .2s}.lights-on .lamp{fill:#ffe2a7;filter:drop-shadow(0 0 7px #ffc268)}.address-row{display:flex;align-items:center;justify-content:space-between;gap:18px;padding:0 27px 26px;border-bottom:1px solid #335054}.address-row label{margin:0;color:#dbe7df;font-size:13px}.address-row small{display:block;color:#9ab7b3;font-size:11px;font-weight:400;margin-top:5px}.address-input{display:flex;align-items:center;gap:9px;font-family:var(--mono);color:#9ab7b3;font-size:10px}.address-input input{font-family:var(--mono);font-size:30px;line-height:1;text-align:center;color:white;background:#29464a;border:1px solid #486366;width:106px;padding:6px;min-height:56px;appearance:textfield}.address-input input::-webkit-inner-spin-button{appearance:none}.function-row{display:flex;align-items:center;justify-content:space-between;gap:15px;padding:24px 27px}.function-name{display:flex;align-items:center;gap:12px}.function-icon{display:grid;place-items:center;width:39px;height:39px;border:1px solid #486366;border-radius:11px;color:var(--orange)}.function-icon svg{width:21px;height:21px}.function-name h2{font-size:16px;margin:0;font-weight:600}.function-name p{margin:3px 0 0;font-family:var(--mono);font-size:10px;color:#9ab7b3}.light-buttons{display:flex;padding:4px;border:1px solid #486366;border-radius:10px;gap:4px}.light-buttons button{border:0;background:transparent;color:#b7cdc7;font-size:12px;font-weight:700;min-width:63px;min-height:39px;border-radius:6px}.light-buttons button[aria-pressed=true]{background:var(--orange);color:var(--ink)}.train-card .notice{padding:0 27px 14px;margin:0;color:#d7e8df;min-height:28px}.train-card .notice.error{color:#ffb7a8}.side{display:flex;flex-direction:column;gap:20px}.signal-card{background:var(--white);border:1px solid var(--line);border-radius:21px;padding:24px;flex:1}.signal-card h2{margin:0;font-size:19px;font-weight:650}.signal-heading{display:flex;align-items:center;justify-content:space-between;gap:10px}.signal-status{font-size:10px;display:flex;align-items:center;gap:5px}.signal-status.live .dot{background:#348a65}.wave{height:68px;width:100%;margin:23px 0 18px}.signal-details{display:flex;justify-content:space-between;gap:10px;border-top:1px solid var(--line);padding-top:13px;font-size:11px}.signal-details strong{display:block;font-family:var(--mono);font-size:15px;margin-top:4px;font-weight:500}.signal-card p{font-size:12px;color:var(--muted);margin:17px 0 0}.bench-card{border:1px dashed #c7cdc1;border-radius:16px;padding:18px 22px;font-size:12px;display:flex;gap:12px;color:var(--muted)}.bench-card svg{width:20px;height:20px;flex:none;margin-top:2px}.bench-card strong{display:block;color:var(--ink);font-size:12px;margin-bottom:4px}.bench-card p{margin:0}.diagnostics{margin-top:22px;border-bottom:1px solid var(--line);padding-bottom:13px}.diagnostics summary{cursor:pointer;font-size:11px;color:var(--muted);padding:7px 0;list-style-position:inside}.diagnostic-data{display:grid;grid-template-columns:repeat(4,1fr);gap:15px;margin:16px 0 8px}.diagnostic-data dt{font-size:10px;color:var(--muted)}.diagnostic-data dd{margin:5px 0 0;font-family:var(--mono);font-size:11px}.footer{display:flex;justify-content:space-between;gap:12px;padding-top:22px;font-family:var(--mono);font-size:10px;color:var(--muted)}.offline-note{background:#f7e5dd;border:1px solid #d8b3a1;padding:11px 14px;border-radius:9px;color:#893d2e;margin-top:22px;font-size:12px}[hidden]{display:none!important}@media(max-width:760px){main{padding:23px 19px}.brand img{width:44px;height:44px}.wordmark{font-size:22px}.top-actions{gap:10px}.connection{font-size:0}.connection .dot{width:8px;height:8px}.intro{margin-top:29px;display:block}.intro h1{letter-spacing:-1.3px}.mode-badge{display:inline-flex;margin-top:18px}.dashboard{grid-template-columns:1fr}.train-card{min-height:0}.train-art{height:160px}.side{display:grid;grid-template-columns:1.2fr 1fr;gap:14px}.signal-card{padding:20px}.bench-card{padding:19px;display:block}.bench-card svg{margin-bottom:12px}.setup-content{grid-template-columns:1fr;gap:14px}.diagnostic-data{grid-template-columns:1fr 1fr}.footer{font-size:9px}}@media(max-width:420px){.side{grid-template-columns:1fr}.bench-card{display:flex}.bench-card svg{margin:0}.function-row,.address-row{padding-inline:21px}.address-input{flex-shrink:0}.address-input>span{display:none}.address-input input{width:93px}.function-row{flex-wrap:wrap}.train-card .card-top{padding-inline:21px}.function-name{gap:9px}.light-buttons button{min-width:52px}.brand small{font-size:8px;letter-spacing:1.6px}.top-actions{gap:7px}}

.roster-toolbar{display:flex;justify-content:space-between;align-items:center;gap:16px;margin-bottom:18px}.roster-toolbar h2{font-size:19px;margin:0;font-weight:650}.roster-count{font-size:12px;color:var(--muted);margin:4px 0 0}.roster{display:grid;grid-template-columns:repeat(2,minmax(0,1fr));gap:20px}.roster:has(>.train-card:only-child){grid-template-columns:minmax(0,600px)}.train-card{min-height:0}.train-card .card-top{padding:20px 24px 0}.edit-loco{border:1px solid #486366;border-radius:7px;background:transparent;color:#dbe7df;font-size:11px;padding:6px 12px;min-height:34px}.loco-identity{padding:12px 24px 0;display:flex;align-items:center;justify-content:space-between;gap:15px}.loco-name{font-size:25px;line-height:1.2;letter-spacing:-.6px;margin:0;overflow-wrap:anywhere;min-width:0}.loco-address{white-space:nowrap;flex-shrink:0}.train-art{height:145px}.train-art>svg{height:125px;max-width:340px}.train-card:nth-child(even) .train-art>svg>rect:first-of-type{fill:#b4c9db}.train-card:nth-child(even) .train-art>svg>path:nth-of-type(2){fill:#e4eaf2}.function-row{border-top:1px solid #335054;padding:19px 24px}.function-name h4{font-size:16px;margin:0;font-weight:600}.train-card .notice{padding:0 24px 12px;min-height:24px}.signal-strip{margin-top:22px}.signal-strip .side{display:grid;grid-template-columns:1.5fr 1fr;gap:20px}.signal-card{padding:20px 24px;border-radius:16px}.signal-card>.eyebrow{margin-bottom:7px}.signal-card .wave{height:35px;margin:14px 0}.signal-details{padding-top:10px}.signal-details strong{display:inline;font-size:12px;margin-left:8px}.signal-card p:last-child{margin-top:10px}.bench-card{align-items:center}.packet-list{display:grid;gap:7px;margin-top:16px}.packet-row{display:grid;grid-template-columns:minmax(0,1fr) auto auto;gap:16px;font-family:var(--mono);font-size:11px;padding:9px 0;border-bottom:1px solid var(--line)}.packet-row>span:first-child{overflow-wrap:anywhere}.empty-roster{padding:48px 24px;text-align:center;border:1px dashed #b6c4b7;border-radius:18px;color:var(--muted)}.empty-roster strong{font-size:19px;color:var(--ink)}.empty-roster p{margin-bottom:0}dialog{border:1px solid var(--line);border-radius:20px;background:var(--white);color:var(--ink);padding:26px;width:min(480px,calc(100% - 32px));max-height:calc(100dvh - 32px);overflow:auto;box-shadow:0 25px 100px #142d3240}dialog::backdrop{background:#102b3280;backdrop-filter:blur(4px)}.editor-heading{display:flex;align-items:center;justify-content:space-between;gap:12px}.editor-heading h2{font-size:22px;letter-spacing:-.5px;margin:0}.icon-button{border:0;background:none;color:var(--muted);font-size:25px;width:36px;height:36px}.editor-actions{display:flex;align-items:center;justify-content:space-between;flex-wrap:wrap;gap:18px;margin-top:22px}.editor-actions>div{display:flex;gap:8px;margin-left:auto}.editor-actions button{font-size:12px}#loco-address{font-family:var(--mono);font-size:20px}button:disabled{cursor:not-allowed}button:not(:disabled):hover{filter:brightness(1.08)}.edit-loco:hover{background:#29464a}
@media(max-width:760px){.roster{grid-template-columns:1fr}.roster:has(>.train-card:only-child){grid-template-columns:1fr}.signal-strip .side{grid-template-columns:1fr 1fr}.loco-identity{padding-inline:21px}.train-art{height:138px}.roster-toolbar .small-button{padding:10px;font-size:11px}.roster-toolbar h2{font-size:17px}.loco-name{font-size:24px}}
@media(max-width:420px){.signal-strip .side{grid-template-columns:1fr}.roster-toolbar{gap:10px}.roster-count{font-size:11px}.function-row{padding-inline:21px}.packet-row{gap:9px;font-size:10px}dialog{padding:20px}.editor-actions{gap:12px}.editor-actions button{padding-inline:11px}}

.roster-actions{display:flex;align-items:center;gap:9px;flex-wrap:wrap;justify-content:flex-end}.programming{margin-top:20px;border:1px solid var(--line);border-radius:16px;background:var(--white)}.programming>summary{list-style:none;cursor:pointer;display:flex;justify-content:space-between;align-items:center;gap:14px;padding:17px 22px;font-size:13px;font-weight:650}.programming>summary::-webkit-details-marker{display:none}.program-summary{display:flex;align-items:center;gap:9px}.program-summary svg{height:18px;width:18px}.program-badge{font-family:var(--mono);font-size:9px;border:1px solid #d9c8ab;border-radius:999px;padding:5px 9px;background:#fcf2df;color:#86602b;white-space:nowrap}.program-content{border-top:1px solid var(--line);padding:24px}.program-intro{font-size:13px;max-width:680px;color:var(--muted);margin:0 0 20px}.program-grid{display:grid;grid-template-columns:1fr 1fr;gap:28px}.program-grid h3{font-size:17px;margin:0 0 8px;letter-spacing:-.3px}.program-grid p{font-size:12px;color:var(--muted);margin:0 0 15px}.program-result{font-family:var(--mono);font-size:29px;line-height:1.3;color:var(--muted);padding:10px 0 14px}.program-grid input{max-width:160px}.programming .advanced-cvs{margin-top:23px;border-top:1px solid var(--line);padding-top:15px}.advanced-cvs summary{font-size:12px;cursor:pointer;color:var(--muted)}.cv-fields{display:flex;gap:16px;align-items:flex-end;flex-wrap:wrap;margin-top:8px}.cv-fields>div{flex:0 0 112px}.cv-fields input{max-width:none;width:100%;min-width:0}.cv-fields label{margin-top:5px}.program-footnote{font-size:11px;color:var(--muted);margin:20px 0 0}.program-link{display:block;background:none;border:0;padding:6px 0;color:#437d65;text-decoration:underline;text-underline-offset:3px;font-size:11px;text-align:left}.programming[open]>summary{background:#eef3e9;border-radius:15px 15px 0 0}
@media(max-width:760px){.roster-toolbar{align-items:flex-start}.roster-actions{max-width:185px}.program-grid{grid-template-columns:1fr;gap:22px}.program-content{padding:20px}.programming>summary{padding-inline:18px}.program-badge{font-size:8px}.programming .cv-fields{gap:10px}.programming .small-button{font-size:11px}}
@media(max-width:420px){.roster-toolbar{flex-wrap:wrap}.roster-toolbar>div:first-child{width:100%}.roster-actions{max-width:none;width:100%;justify-content:flex-start}}
</style>
</head>
<body>
<main>
<header class="topbar"><a class="brand" href="/" aria-label="anden-dcc home"><img src="/icon.svg" alt="" width="52" height="52"><div><div class="wordmark">anden<span>-dcc</span></div><small data-i18n="brandTag">Small scale. Full character.</small></div></a><div class="top-actions"><span id="connection" class="connection" role="status"><i class="dot"></i><span id="connection-text">Connecting</span></span><div class="language" aria-label="Language"><button type="button" data-lang="en" aria-pressed="true">EN</button><button type="button" data-lang="es" aria-pressed="false">ES</button></div></div></header>
<details id="setup" class="setup"><summary><span class="summary-label"><svg viewBox="0 0 24 24" fill="none" stroke="currentColor" stroke-width="1.6" aria-hidden="true"><path d="M4 7h16M4 17h16M8 4v6M16 14v6"/></svg><span data-i18n="setup">Setup</span></span><span class="plus" aria-hidden="true">+</span></summary><div class="setup-content"><section class="setup-panel"><h2 data-i18n="wifiTitle">Your Wi-Fi</h2><p id="wifi-status" role="status"></p><div id="network-links" class="network-links"></div><form id="wifi"><label for="ssid" data-i18n="networkName">Network name</label><input id="ssid" name="ssid" maxlength="32" autocomplete="off" required><label for="password" data-i18n="password">Network password</label><input id="password" name="password" type="password" maxlength="63" autocomplete="new-password"><small class="field-note" data-i18n="wifiHelp">2.4 GHz networks. Leave the password empty only for an open network.</small><div class="form-actions"><button class="small-button" type="submit" data-i18n="saveConnect">Save & connect</button><button id="forget" class="small-button danger" type="button" data-i18n="forget">Forget network</button></div></form><p id="wifi-message" class="notice" role="status"></p></section><section class="setup-panel"><h2 data-i18n="firmwareTitle">Firmware update</h2><p><span data-i18n="installed">Installed</span> <strong data-version>—</strong></p><form id="firmware"><label for="firmware-file" data-i18n="firmwareFile">Firmware file (.bin)</label><input id="firmware-file" name="firmware" type="file" accept=".bin" required><small class="field-note" data-i18n="firmwareHelp">Use an anden-dcc .bin built for Pico W with the same memory layout. The signal stops during installation.</small><div class="form-actions"><button id="update-button" class="small-button" type="submit" data-i18n="installUpdate">Install update</button></div></form><progress id="upload-progress" max="100" value="0" hidden aria-label="Firmware upload"></progress><p id="update-message" class="notice" role="status"></p><p data-i18n="recoveryHelp">If your router is unavailable, connect to anden-dcc and open 192.168.42.1.</p></section></div></details>
<div id="offline-note" class="offline-note" role="status" hidden data-i18n="offlineNote">The controller is not responding. Check your Wi-Fi connection.</div>
<section class="intro"><div><p class="eyebrow" data-i18n="eyebrow">A place for your trains</p><h1 data-i18n="headline">Bring the scene to life.</h1><p class="intro-copy" data-i18n="intro">A little light. A railway of your own.</p></div><span class="mode-badge"><i class="dot"></i><span data-i18n="benchMode">BENCH MODE · LOGIC ONLY</span></span></section>
<section class="roster-section" aria-labelledby="roster-title">
<div class="roster-toolbar"><div><h2 id="roster-title" data-i18n="rosterTitle">Your locomotives</h2><p id="roster-count" class="roster-count"></p></div><div class="roster-actions"><button id="show-programming" class="small-button outline" type="button" data-i18n="programming">Programming</button><button id="add-loco" class="small-button" type="button" disabled><span aria-hidden="true">+</span><span data-i18n="addLoco">Add locomotive</span></button></div></div>
<div id="roster" class="roster"></div>
<div id="empty-roster" class="empty-roster" hidden><strong data-i18n="emptyTitle">A platform waiting for its first train.</strong><p data-i18n="emptyHelp">Add a locomotive with the short address stored in its decoder.</p></div>
<p id="roster-message" class="notice" role="status"></p></section>
<details id="programming" class="programming"><summary><span class="program-summary"><svg viewBox="0 0 24 24" fill="none" stroke="currentColor" stroke-width="1.5" aria-hidden="true"><rect x="6" y="6" width="12" height="12" rx="2"/><path d="M9 2v4m6-4v4M9 18v4m6-4v4M2 9h4m-4 6h4m12-6h4m-4 6h4"/></svg><span data-i18n="programming">Programming</span></span><span id="programming-status" class="program-badge" role="status">Hardware needed</span></summary><div class="program-content"><button id="back-to-card" class="program-link" type="button" hidden data-i18n="backToCard">Back to the locomotive card</button><p class="program-intro" data-i18n="programIntro">Forgotten an address? Service mode can read the decoder without knowing it first. Use one locomotive on an isolated programming track.</p><div class="program-grid"><section><h3 data-i18n="readAddressTitle">Find its address</h3><p data-i18n="readAddressHelp">Read the decoder's primary short or long address. A roster entry is not a decoder read.</p><div class="program-result" aria-label="Decoder address">—</div><button id="read-address" class="small-button program-action" type="button" disabled data-i18n="readAddress">Read address</button></section><section><h3 data-i18n="setAddressTitle">Give it a known address</h3><p data-i18n="setAddressHelp">Program a short address (1–127), preserving the other decoder settings. Verify it before updating a roster card.</p><label for="program-address" data-i18n="newAddress">New decoder address</label><input id="program-address" type="number" min="1" max="127" step="1" placeholder="1–127" disabled><div class="form-actions"><button id="write-address" class="small-button program-action" type="button" disabled data-i18n="writeAddress">Write address</button></div></section></div><p id="programming-help" class="notice" data-i18n="programUnavailable">Read/write is not enabled yet. The powered programming output and decoder-response sensing still need to be connected and tested.</p><details class="advanced-cvs"><summary data-i18n="cvTitle">Advanced · Configuration variables (CVs)</summary><div class="cv-fields"><div><label for="program-cv" data-i18n="cvNumber">CV number</label><input id="program-cv" type="number" min="1" max="1024" value="1" disabled></div><div><label for="program-value" data-i18n="cvValue">Value</label><input id="program-value" type="number" min="0" max="255" placeholder="0–255" disabled></div><button class="small-button outline program-action" type="button" disabled data-i18n="readCv">Read CV</button><button class="small-button outline program-action" type="button" disabled data-i18n="writeCv">Write CV</button></div></details><p class="program-footnote" data-i18n="programOneLoco">Only one decoder on the programming output: service-mode writes can affect every decoder connected to it. No factory reset is needed to recover an address.</p></div></details>
<div class="signal-strip"><aside class="side"><section class="signal-card"><p class="eyebrow" data-i18n="signalEyebrow">On the wire</p><div class="signal-heading"><h2 data-i18n="signalTitle">DCC signal</h2><span id="signal-status" class="signal-status"><i class="dot"></i><span id="signal-text">—</span></span></div><svg class="wave" viewBox="0 0 280 70" preserveAspectRatio="none" aria-hidden="true"><path d="M0 55h280M0 14h280" stroke="#e4e9df" stroke-dasharray="3 5"/><path d="M0 55h16V14h20v41h20V14h20v41h35V14h35v41h20V14h20v41h35V14h35v41h24" fill="none" stroke="#437d65" stroke-width="2.4" stroke-linejoin="round"/></svg><div class="signal-details"><div><span data-i18n="outputPin">Output pin</span><strong>GP2</strong></div><div><span data-i18n="logicLevel">Logic level</span><strong>3.3 V</strong></div></div><p data-i18n="signalHelp">Ready for the logic analyzer. The powered track output is the next stage.</p></section><section class="bench-card"><svg viewBox="0 0 24 24" fill="none" stroke="currentColor" stroke-width="1.5" aria-hidden="true"><path d="M9 3v7l-5 9a1.4 1.4 0 0 0 1.2 2h13.6a1.4 1.4 0 0 0 1.2-2l-5-9V3M8 3h8M7 15h10"/></svg><div><strong data-i18n="benchTitle">The diorama starts here.</strong><p data-i18n="benchHelp">F0 is ready to test. Track power and movement are not enabled yet.</p></div></section></aside></div>
<details class="diagnostics"><summary data-i18n="diagnostics">Signal details</summary><p class="field-note" data-i18n="refreshHelp">Every locomotive is refreshed automatically, even with this page closed.</p><div id="packet-list" class="packet-list"></div><dl class="diagnostic-data"><div><dt data-i18n="halfBits">Half-bit timing</dt><dd>58 / 100 µs</dd></div><div><dt data-i18n="trackPower">Track power</dt><dd data-i18n="notEnabled">Not enabled</dd></div></dl></details>
<dialog id="loco-dialog" aria-labelledby="editor-title"><form id="loco-form"><div class="editor-heading"><h2 id="editor-title">Add locomotive</h2><button id="close-editor" class="icon-button" type="button" aria-label="Close">×</button></div><input id="loco-id" type="hidden"><label for="loco-name" data-i18n="locoName">Name</label><input id="loco-name" maxlength="48" autocomplete="off"><small class="field-note" data-i18n="nameHelp">Optional. Give it a name that feels at home on your railway.</small><label for="loco-address" data-i18n="address">Locomotive address</label><input id="loco-address" type="number" min="1" max="127" step="1" required><small class="field-note" data-i18n="addressHelp">The short address stored in your decoder.</small><button id="forgot-address" class="program-link" type="button" data-i18n="forgotAddress">Don’t know the address?</button><small class="field-note" data-i18n="rosterOnly">Saving this card changes the roster, not the decoder.</small><p class="field-note" data-i18n="editHelp">Changing the address starts this card with headlights off. The previous decoder keeps its last state.</p><p id="editor-message" class="notice" role="status"></p><div class="editor-actions"><button id="remove-loco" class="small-button danger" type="button" hidden data-i18n="removeLoco">Remove</button><div><button id="cancel-editor" class="small-button outline" type="button" data-i18n="cancel">Cancel</button><button id="save-loco" class="small-button" type="submit" data-i18n="saveLoco">Save locomotive</button></div></div></form></dialog>
<template id="loco-template"><article class="train-card"><div class="card-top"><span class="eyebrow slot-number"></span><button class="edit-loco" type="button" data-i18n="editLoco">Edit</button></div><div class="loco-identity"><h3 class="loco-name"></h3><span class="track-pill loco-address"></span></div><div class="train-art" aria-hidden="true"><div class="rails"></div><svg viewBox="0 0 380 145"><path d="M45 112h284l-16 12H61z" fill="#0b2024"/><rect x="66" y="45" width="248" height="63" rx="16" fill="#c1d9c8"/><path d="M90 35h193a19 19 0 0 1 19 19H76a14 14 0 0 1 14-19" fill="#eff1db"/><path d="M66 70h248v18H66z" fill="#f2b768"/><rect x="87" y="49" width="48" height="22" rx="4" fill="#26464c"/><rect x="144" y="49" width="48" height="22" rx="4" fill="#26464c"/><rect x="201" y="49" width="48" height="22" rx="4" fill="#26464c"/><path d="M268 47h20l15 24h-35z" fill="#26464c"/><path d="M231 19h34l-8 15h-19z" fill="none" stroke="#bdd5c4" stroke-width="3"/><path d="M247 19v-6h30" fill="none" stroke="#bdd5c4" stroke-width="3"/><circle cx="107" cy="111" r="13" fill="#0b2024" stroke="#819d94" stroke-width="4"/><circle cx="133" cy="111" r="13" fill="#0b2024" stroke="#819d94" stroke-width="4"/><circle cx="250" cy="111" r="13" fill="#0b2024" stroke="#819d94" stroke-width="4"/><circle cx="276" cy="111" r="13" fill="#0b2024" stroke="#819d94" stroke-width="4"/><path d="M313 88h7v15h-7" fill="#8da99d"/><circle class="lamp" cx="300" cy="89" r="5"/><circle class="lamp" cx="80" cy="89" r="5"/><path d="M171 87h31v16h-31" fill="#142d32" opacity=".15"/></svg></div><div class="function-row"><div class="function-name"><span class="function-icon"><svg viewBox="0 0 24 24" fill="none" stroke="currentColor" stroke-width="1.6" aria-hidden="true"><path d="M8 15c0-2-3-3-3-7a7 7 0 0 1 14 0c0 4-3 5-3 7M8 15h8M9 19h6M10 22h4"/></svg></span><div><h4 data-i18n="lights">Headlights</h4><p>F0 · <span class="light-state">—</span></p></div></div><div class="light-buttons" role="group"><button class="dcc-action" type="button" data-on="0" aria-pressed="false" disabled data-i18n="off">Off</button><button class="dcc-action" type="button" data-on="1" aria-pressed="false" disabled data-i18n="on">On</button></div></div><p class="loco-message notice" role="status"></p></article></template>
<footer class="footer"><span data-i18n="footer">Built for trains on display.</span><span>anden-dcc <span data-version>—</span> · PICO W</span></footer>
</main>
<script>
const translations={en:{brandTag:'Small scale. Full character.',setup:'Setup',wifiTitle:'Your Wi-Fi',networkName:'Network name',password:'Network password',wifiHelp:'2.4 GHz networks. Leave the password empty only for an open network.',saveConnect:'Save & connect',forget:'Forget network',firmwareTitle:'Firmware update',installed:'Installed',firmwareFile:'Firmware file (.bin)',firmwareHelp:'Use an anden-dcc .bin built for Pico W with the same memory layout. The signal stops during installation.',installUpdate:'Install update',recoveryHelp:'If your router is unavailable, connect to anden-dcc and open 192.168.42.1.',offlineNote:'The controller is not responding. Check your Wi-Fi connection.',eyebrow:'A place for your trains',headline:'Bring the scene to life.',intro:'A little light. A railway of your own.',benchMode:'BENCH MODE · LOGIC ONLY',locomotive:'Locomotive',dccShort:'DCC · SHORT ADDRESS',address:'Locomotive address',addressHelp:'The short address stored in your decoder.',lights:'Headlights',off:'Off',on:'On',stateOn:'On',stateOff:'Off',signalEyebrow:'On the wire',signalTitle:'DCC signal',outputPin:'Output pin',logicLevel:'Logic level',signalHelp:'Ready for the logic analyzer. The powered track output is the next stage.',benchTitle:'The diorama starts here.',benchHelp:'F0 is ready to test. Track power and movement are not enabled yet.',diagnostics:'Signal details',packet:'Packet bytes',sentAddress:'Transmitting to',halfBits:'Nominal half-bit timing',trackPower:'Track power',notEnabled:'Not enabled',footer:'Built for trains on display.',connected:'Connected',connecting:'Connecting',offline:'Offline',active:'Active',stopped:'Stopped',networkConnected:'Connected to {ssid}',networkTrying:'Trying {ssid}. Check the network details if it does not connect.',networkEmpty:'No network configured.',storageError:'Could not open the configuration storage.',saving:'Saving…',saved:'Network saved. Connecting… Switch back to your Wi-Fi when anden-dcc disappears.',saveError:'Could not save the network. Check the name and password.',forgotten:'Network forgotten. Connect to anden-dcc to configure it again.',forgetError:'Could not forget the network.',sending:'Sending…',commandSent:'Lights {state} · address {address}',commandError:'Could not send the command. Check the connection and try again.',notReady:'The signal generator is not available.',uploading:'Uploading firmware…',uploadSuccess:'Update installed. Restarting and reconnecting…',uploadError:'Update failed. Choose a compatible .bin and try again.',invalidFile:'Choose a .bin firmware file.',confirmForget:'Forget the saved Wi-Fi network? You will need to reconnect to anden-dcc.',selectedAddress:'Selected address',title:'anden-dcc · Diorama control'},es:{brandTag:'Pequeña escala. Gran carácter.',setup:'Configuración',wifiTitle:'Tu red Wi-Fi',networkName:'Nombre de la red',password:'Contraseña de la red',wifiHelp:'Redes de 2,4 GHz. Deja la contraseña vacía solo para una red abierta.',saveConnect:'Guardar y conectar',forget:'Olvidar red',firmwareTitle:'Actualizar firmware',installed:'Instalado',firmwareFile:'Archivo de firmware (.bin)',firmwareHelp:'Usa un .bin de anden-dcc para Pico W con la misma distribución de memoria. La señal se detiene durante la instalación.',installUpdate:'Instalar actualización',recoveryHelp:'Si tu router no está disponible, conecta a anden-dcc y abre 192.168.42.1.',offlineNote:'La central no responde. Comprueba tu conexión Wi-Fi.',eyebrow:'Un lugar para tus trenes',headline:'Dale vida a tu escena.',intro:'Un poco de luz. Un ferrocarril muy tuyo.',benchMode:'MODO DE PRUEBA · SOLO SEÑAL',locomotive:'Locomotora',dccShort:'DCC · DIRECCIÓN CORTA',address:'Dirección de locomotora',addressHelp:'La dirección corta guardada en el decodificador.',lights:'Luces frontales',off:'Apagar',on:'Encender',stateOn:'Encendidas',stateOff:'Apagadas',signalEyebrow:'En los carriles',signalTitle:'Señal DCC',outputPin:'Pin de salida',logicLevel:'Nivel lógico',signalHelp:'Lista para el analizador lógico. La salida de potencia es la siguiente etapa.',benchTitle:'El diorama empieza aquí.',benchHelp:'F0 ya se puede probar. La potencia y el movimiento aún no están habilitados.',diagnostics:'Detalles de la señal',packet:'Bytes del paquete',sentAddress:'Transmitiendo a',halfBits:'Tiempo nominal de semibit',trackPower:'Potencia en vía',notEnabled:'Sin habilitar',footer:'Hecho para tus trenes en exposición.',connected:'Conectada',connecting:'Conectando',offline:'Sin conexión',active:'Activa',stopped:'Detenida',networkConnected:'Conectada a {ssid}',networkTrying:'Intentando conectar a {ssid}. Revisa los datos si no conecta.',networkEmpty:'No hay ninguna red configurada.',storageError:'No se pudo abrir la memoria de configuración.',saving:'Guardando…',saved:'Red guardada. Conectando… Vuelve a tu Wi-Fi cuando desaparezca anden-dcc.',saveError:'No se pudo guardar la red. Revisa el nombre y la contraseña.',forgotten:'Red olvidada. Conecta a anden-dcc para configurarla de nuevo.',forgetError:'No se pudo olvidar la red.',sending:'Enviando…',commandSent:'Luces {state} · dirección {address}',commandError:'No se pudo enviar la orden. Revisa la conexión e inténtalo de nuevo.',notReady:'El generador de señal no está disponible.',uploading:'Subiendo firmware…',uploadSuccess:'Actualización instalada. Reiniciando y reconectando…',uploadError:'La actualización ha fallado. Elige un .bin compatible e inténtalo de nuevo.',invalidFile:'Elige un archivo de firmware .bin.',confirmForget:'¿Olvidar la red Wi-Fi guardada? Tendrás que volver a conectar a anden-dcc.',selectedAddress:'Dirección seleccionada',title:'anden-dcc · Control del diorama'}};
Object.assign(translations.en, {
  rosterTitle:'Your locomotives', addLoco:'Add locomotive', editLoco:'Edit',
  editTitle:'Edit locomotive', locoName:'Name', nameHelp:'Optional. Give it a name that feels at home on your railway.',
  namePlaceholder:'e.g. The evening express', saveLoco:'Save locomotive', cancel:'Cancel', removeLoco:'Remove', close:'Close',
  editHelp:'Changing the address starts this card with headlights off. The previous decoder keeps its last state.',
  emptyTitle:'A platform waiting for its first train.', emptyHelp:'Add a locomotive with the short address stored in its decoder.',
  rosterCount:'{count} of {max} spaces · saved on the controller', slot:'LOCOMOTIVE {number}',
  defaultName:'Locomotive {number}', addressBadge:'DCC {address}',
  refreshHelp:'Every locomotive is refreshed automatically, even with this page closed.',
  saveLocoError:'Could not save. Check the connection and try again.',
  duplicateAddress:'That address is already in your roster, or the roster is full.',
  invalidName:'Use a name up to 48 UTF-8 bytes, without control characters.',
  rosterChanged:'This locomotive was changed or removed. Close this window and try again.',
  removeError:'Could not remove the locomotive. Try again.',
  confirmRemove:'Remove {name} from the roster? Its decoder keeps its last state. Turn off its lights first if needed.',
  commandSent:'Lights {state}', pending:'Sending…', packet:'Packet bytes', sentAddress:'Refreshed addresses'
});
Object.assign(translations.es, {
  rosterTitle:'Tus locomotoras', addLoco:'Añadir locomotora', editLoco:'Editar',
  editTitle:'Editar locomotora', locoName:'Nombre', nameHelp:'Opcional. Dale un nombre que encaje en tu ferrocarril.',
  namePlaceholder:'p. ej. El expreso de la tarde', saveLoco:'Guardar locomotora', cancel:'Cancelar', removeLoco:'Eliminar', close:'Cerrar',
  editHelp:'Al cambiar la dirección, esta tarjeta empieza con las luces apagadas. El decodificador anterior conserva su último estado.',
  emptyTitle:'Un andén esperando su primer tren.', emptyHelp:'Añade una locomotora con la dirección corta guardada en su decodificador.',
  rosterCount:'{count} de {max} plazas · guardadas en la central', slot:'LOCOMOTORA {number}',
  defaultName:'Locomotora {number}', addressBadge:'DCC {address}',
  refreshHelp:'Todas las locomotoras se actualizan automáticamente, incluso con esta página cerrada.',
  saveLocoError:'No se pudo guardar. Revisa la conexión e inténtalo de nuevo.',
  duplicateAddress:'Esa dirección ya está en la lista o no quedan plazas libres.',
  invalidName:'Usa un nombre de hasta 48 bytes UTF-8, sin caracteres de control.',
  rosterChanged:'Esta locomotora ha cambiado o se ha eliminado. Cierra esta ventana e inténtalo de nuevo.',
  removeError:'No se pudo eliminar la locomotora. Inténtalo de nuevo.',
  confirmRemove:'¿Eliminar {name} de la lista? El decodificador conserva su último estado. Apaga sus luces antes si lo necesitas.',
  commandSent:'Luces {state}', pending:'Enviando…', packet:'Bytes del paquete', sentAddress:'Direcciones actualizadas'
});
Object.assign(translations.en, {
  programming:'Programming', hardwareNeeded:'Hardware needed', programOffline:'Controller offline',
  programIntro:'Forgotten an address? Service mode can read the decoder without knowing it first. Use one locomotive on an isolated programming track.',
  readAddressTitle:'Find its address', readAddressHelp:'Read the decoder’s primary short or long address. A roster entry is not a decoder read.', readAddress:'Read address',
  setAddressTitle:'Give it a known address', setAddressHelp:'Program a short address (1–127), preserving the other decoder settings. Verify it before updating a roster card.',
  newAddress:'New decoder address', writeAddress:'Write address',
  programUnavailable:'Read/write is not enabled yet. The powered programming output and decoder-response sensing still need to be connected and tested.',
  programOneLoco:'Only one decoder on the programming output: service-mode writes can affect every decoder connected to it. No factory reset is needed to recover an address.',
  cvTitle:'Advanced · Configuration variables (CVs)', cvNumber:'CV number', cvValue:'Value', readCv:'Read CV', writeCv:'Write CV',
  forgotAddress:'Don’t know the address?', rosterOnly:'Saving this card changes the roster, not the decoder.',
  backToCard:'Back to the locomotive card', programAddressLabel:'Decoder address (not read yet)'
});
Object.assign(translations.es, {
  programming:'Programación', hardwareNeeded:'Falta el hardware', programOffline:'Central sin conexión',
  programIntro:'¿Has olvidado la dirección? El modo de servicio puede leer el decodificador sin conocerla. Usa una sola locomotora en una vía de programación aislada.',
  readAddressTitle:'Encontrar su dirección', readAddressHelp:'Lee la dirección principal corta o larga del decodificador. La lista de locomotoras no es una lectura del decodificador.', readAddress:'Leer dirección',
  setAddressTitle:'Asignar una dirección conocida', setAddressHelp:'Programa una dirección corta (1–127) conservando los demás ajustes. Verifícala antes de actualizar una tarjeta.',
  newAddress:'Nueva dirección del decodificador', writeAddress:'Escribir dirección',
  programUnavailable:'La lectura y escritura aún no están habilitadas. Hay que conectar y probar la salida de programación alimentada y la detección de respuestas del decodificador.',
  programOneLoco:'Un solo decodificador en la salida de programación: las escrituras de servicio pueden afectar a todos los conectados. No hace falta un reinicio de fábrica para recuperar una dirección.',
  cvTitle:'Avanzado · Variables de configuración (CV)', cvNumber:'Número de CV', cvValue:'Valor', readCv:'Leer CV', writeCv:'Escribir CV',
  forgotAddress:'¿No sabes la dirección?', rosterOnly:'Guardar esta tarjeta cambia la lista, no el decodificador.',
  backToCard:'Volver a la tarjeta de la locomotora', programAddressLabel:'Dirección del decodificador (aún sin leer)'
});
const $=id=>document.getElementById(id);
let language='en';
try { if(localStorage.getItem('anden-language')==='es') language='es'; } catch(e) {}
let state=null, reachable=null, busy=false, updating=false, initializedSsid=false, polling=false, revision=0;
const cardMessages=new Map();
const locos=()=>state?.dcc?.locos||[];
function t(key,values={}) {
  if(values.stateKey) values={...values,state:translations[language][values.stateKey]};
  let text=translations[language][key]||translations.en[key]||key;
  for(const [key,value] of Object.entries(values)) text=text.replaceAll('{'+key+'}',String(value));
  return text;
}
function locoName(loco) { return loco.name||t('defaultName',{number:String(loco.id).padStart(2,'0')}); }
function notice(id,key,error=false,values={}) {
  const el=$(id);el.dataset.noticeKey=key;el.dataset.noticeValues=JSON.stringify(values);
  el.textContent=t(key,values);el.classList.toggle('error',error);
}
function applyLanguage() {
  document.documentElement.lang=language; document.title=t('title');
  document.querySelectorAll('[data-i18n]').forEach(el=>el.textContent=t(el.dataset.i18n));
  document.querySelectorAll('[data-lang]').forEach(el=>el.setAttribute('aria-pressed',String(el.dataset.lang===language)));
  document.querySelectorAll('[data-notice-key]').forEach(el=>el.textContent=t(el.dataset.noticeKey,JSON.parse(el.dataset.noticeValues||'{}')));
  $('close-editor').setAttribute('aria-label',t('close'));
  document.querySelector('.program-result').setAttribute('aria-label',t('programAddressLabel'));
  $('loco-name').placeholder=t('namePlaceholder');
  $('editor-title').textContent=t($('loco-id').value?'editTitle':'addLoco');
  render();
}
function renderRoster() {
  const items=locos(), holder=$('roster');
  const ids=items.map(l=>l.id).join(',');
  if(holder.dataset.ids!==ids) {
    holder.replaceChildren(); holder.dataset.ids=ids;
    for(const loco of items) {
      const card=$('loco-template').content.firstElementChild.cloneNode(true);
      card.dataset.id=loco.id;
      card.querySelector('.loco-name').id='loco-title-'+loco.id;
      card.setAttribute('aria-labelledby','loco-title-'+loco.id);
      card.querySelector('.edit-loco').onclick=()=>openEditor(loco.id);
      card.querySelectorAll('.dcc-action').forEach(button=>button.onclick=()=>sendF0(loco.id,button.dataset.on));
      holder.append(card);
    }
  }
  for(const loco of items) {
    const card=holder.querySelector('[data-id="'+loco.id+'"]');
    card.querySelectorAll('[data-i18n]').forEach(el=>el.textContent=t(el.dataset.i18n));
    card.querySelector('.slot-number').textContent=t('slot',{number:String(loco.id).padStart(2,'0')});
    card.querySelector('.loco-name').textContent=locoName(loco);
    card.querySelector('.loco-address').textContent=t('addressBadge',{address:String(loco.address).padStart(2,'0')});
    card.querySelector('.edit-loco').setAttribute('aria-label',t('editLoco')+' · '+locoName(loco));
    card.classList.toggle('lights-on',Boolean(reachable&&loco.f0));
    card.querySelector('.light-state').textContent=t(loco.f0?'stateOn':'stateOff');
    card.querySelector('.light-buttons').setAttribute('aria-label','F0 '+t('lights')+' · '+locoName(loco));
    card.querySelectorAll('.dcc-action').forEach(button=>{
      button.disabled=busy||updating||!reachable||!state?.dcc?.ready;
      button.setAttribute('aria-pressed',String(Number(button.dataset.on)===Number(loco.f0)));
    });
    card.querySelector('.edit-loco').disabled=busy||updating||!reachable;
    const message=cardMessages.get(loco.id), el=card.querySelector('.loco-message');
    el.textContent=message?t(message.key,message.values):'';
    el.classList.toggle('error',Boolean(message?.error));
  }
  $('add-loco').disabled=busy||updating||!reachable||items.length>=(state?.dcc?.maxLocos||8);
  $('roster-count').textContent=state?t('rosterCount',{count:items.length,max:state.dcc.maxLocos||8}):t('connecting');
  $('empty-roster').hidden=!state||items.length>0;
  $('packet-list').replaceChildren();
  for(const loco of items) {
    const row=document.createElement('div');row.className='packet-row';
    for(const value of [locoName(loco),'DCC '+loco.address,loco.bytes]) {
      const cell=document.createElement('span');cell.textContent=value;row.append(cell);
    }
    $('packet-list').append(row);
  }
}
function render() {
  const connected=reachable&&state?.connected;
  $('connection').classList.toggle('online',Boolean(connected));
  $('connection-text').textContent=t(reachable===false?'offline':connected?'connected':'connecting');
  $('offline-note').hidden=reachable!==false;
  $('signal-status').classList.toggle('live',Boolean(reachable&&state?.dcc?.running));
  $('signal-text').textContent=t(reachable&&state?.dcc?.running?'active':'stopped');
  renderRoster();
  $('programming-status').textContent=t(reachable===false?'programOffline':'hardwareNeeded');
  // This release prepares the UI only; no service-mode transport is connected.
  document.querySelectorAll('.program-action').forEach(button=>button.disabled=true);
  $('loco-form').querySelectorAll('button,input').forEach(el=>el.disabled=busy||updating||(!reachable&&!['close-editor','cancel-editor'].includes(el.id)));
  $('update-button').disabled=busy||updating;
  if(!state) return;
  document.querySelectorAll('[data-version]').forEach(el=>el.textContent='v'+state.version);
  $('wifi-status').textContent=t(state.connected?'networkConnected':state.ssid?'networkTrying':'networkEmpty',{ssid:state.ssid||''});
  if(!initializedSsid&&state.ssid){$('ssid').value=state.ssid;initializedSsid=true;}
  $('network-links').replaceChildren();
  if(state.connected) for(const target of [state.ip,state.mdnsReady?'anden-dcc.local':null].filter(Boolean)) {
    const a=document.createElement('a');a.href='http://'+target+'/';a.textContent=target;$('network-links').append(a);
  }
  if(!state.storageReady) notice('wifi-message','storageError',true);
}
async function refresh() {
  if(updating||busy||polling) return;
  polling=true;
  const startedAt=revision;
  try {
    const response=await fetch('/api/status',{cache:'no-store',signal:AbortSignal.timeout(8000)});
    if(!response.ok) throw Error();
    const next=await response.json();
    // A status request started before a user command must not overwrite its result.
    if(!busy&&!updating&&startedAt===revision) {state=next;reachable=true;}
  } catch(e) {if(!busy&&!updating&&startedAt===revision) reachable=false;}
  finally {polling=false;render();}
}
async function command(path,body) {
  const response=await fetch(path,{method:'POST',body:new URLSearchParams(body),signal:AbortSignal.timeout(10000)});
  if(!response.ok) {const error=new Error();error.status=response.status;throw error;}
  state.dcc=await response.json();reachable=true;
}
async function sendF0(id,on) {
  if(busy||updating||!reachable) return;
  const loco=locos().find(l=>l.id===id);if(!loco) return;
  busy=true;revision++;cardMessages.set(id,{key:'sending'});render();
  try {
    await command('/dcc/f0',{address:loco.address,on});
    cardMessages.set(id,{key:'commandSent',values:{stateKey:on==='1'?'stateOn':'stateOff'}});
  } catch(e) {cardMessages.set(id,{key:'commandError',error:true});}
  finally {busy=false;render();}
}
function openEditor(id=null) {
  $('back-to-card').hidden=true;
  if(busy||updating||!reachable) return;
  const loco=locos().find(l=>l.id===id);
  $('loco-id').value=loco?.id||'';$('loco-name').value=loco?.name||'';
  let address=3;while(locos().some(l=>l.address===address)&&address<127) address++;
  $('loco-address').value=loco?.address||address;
  $('remove-loco').hidden=!loco;
  $('editor-title').textContent=t(loco?'editTitle':'addLoco');
  $('editor-message').textContent='';delete $('editor-message').dataset.noticeKey;
  $('loco-dialog').showModal();$('loco-name').focus();
}
function closeEditor(){if(!busy&&!updating)$('loco-dialog').close();}
$('close-editor').onclick=closeEditor;$('cancel-editor').onclick=closeEditor;
$('loco-dialog').addEventListener('cancel',e=>{if(busy||updating)e.preventDefault();});
$('add-loco').onclick=()=>openEditor();
function showProgramming() {
  if(busy||updating)return;
  if($('loco-dialog').open){closeEditor();$('back-to-card').hidden=false;}
  $('programming').open=true;
  $('programming').scrollIntoView({block:'start',behavior:'smooth'});
}
$('show-programming').onclick=showProgramming;
$('forgot-address').onclick=showProgramming;
$('back-to-card').onclick=()=>{if(busy||updating)return;$('back-to-card').hidden=true;$('loco-dialog').showModal();};
$('loco-form').onsubmit=async e=>{
  e.preventDefault();if(busy||updating||!reachable) return;
  const name=$('loco-name').value.trim(),address=Number($('loco-address').value),id=$('loco-id').value;
  if(new TextEncoder().encode(name).length>48||/[\x00-\x1f\x7f]/.test(name)){notice('editor-message','invalidName',true);return;}
  if(locos().some(l=>l.address===address&&String(l.id)!==id)){notice('editor-message','duplicateAddress',true);return;}
  busy=true;revision++;render();notice('editor-message','saving');
  try {await command('/locos/save',{id,address,name});if(id)cardMessages.delete(Number(id));$('loco-dialog').close();}
  catch(error){notice('editor-message',error.status===409?'duplicateAddress':error.status===404?'rosterChanged':'saveLocoError',true);}
  finally {busy=false;render();}
};
$('remove-loco').onclick=async()=>{
  if(busy||updating||!reachable)return;
  const id=$('loco-id').value,loco=locos().find(l=>String(l.id)===id);
  if(!loco||!confirm(t('confirmRemove',{name:locoName(loco)})))return;
  busy=true;revision++;render();
  try {await command('/locos/remove',{id});cardMessages.delete(loco.id);$('loco-dialog').close();}
  catch(error){notice('editor-message','removeError',true);}
  finally {busy=false;render();}
};
document.querySelectorAll('[data-lang]').forEach(button=>button.onclick=()=>{
  language=button.dataset.lang;try{localStorage.setItem('anden-language',language);}catch(e){}applyLanguage();
});

$('wifi').onsubmit=async e=>{e.preventDefault();notice('wifi-message','saving');const submit=e.target.querySelector('[type=submit]');submit.disabled=true;try{const r=await fetch('/wifi/save',{method:'POST',body:new URLSearchParams(new FormData(e.target))});if(!r.ok)throw Error();$('password').value='';notice('wifi-message','saved');}catch(e){notice('wifi-message','saveError',true);}finally{submit.disabled=false;}};
$('forget').onclick=async()=>{if(!window.confirm(t('confirmForget')))return;try{const r=await fetch('/wifi/forget',{method:'POST'});if(!r.ok)throw Error();notice('wifi-message','forgotten');await refresh();}catch(e){notice('wifi-message','forgetError',true);}};
$('firmware').onsubmit=async e=>{e.preventDefault();if(busy||updating)return;revision++;const file=$('firmware-file').files[0];if(!file||!file.name.toLowerCase().endsWith('.bin')){notice('update-message','invalidFile',true);return;}const form=new FormData();form.append('firmware',file);updating=true;render();$('update-button').disabled=true;notice('update-message','uploading');$('upload-progress').hidden=false;const request=new XMLHttpRequest();request.open('POST','/update');request.upload.onprogress=event=>{if(event.lengthComputable)$('upload-progress').value=event.loaded/event.total*100;};request.onload=()=>{if(request.status===200&&request.responseText.includes('Update Success')){notice('update-message','uploadSuccess');setTimeout(()=>location.reload(),12000);}else finishError();};request.onerror=finishError;function finishError(){updating=false;$('update-button').disabled=false;$('upload-progress').hidden=true;notice('update-message','uploadError',true);render();}request.send(form);};
if(new URLSearchParams(location.search).get('setup')==='firmware')$('setup').open=true;
applyLanguage();refresh();setInterval(refresh,3000);
</script>
</body></html>
)WEB";

const char ICON_SVG[] = R"WEB(<svg xmlns="http://www.w3.org/2000/svg" viewBox="0 0 128 128" role="img" aria-labelledby="title"><title id="title">anden-dcc: rails, light and signal</title><rect width="128" height="128" rx="30" fill="#142d32"/><path d="M30 106 54 27h20l24 79M40 78h48M35 94h58" fill="none" stroke="#a6d8c1" stroke-width="8" stroke-linecap="round" stroke-linejoin="round"/><rect x="43" y="39" width="42" height="40" rx="12" fill="#ffb563" stroke="#142d32" stroke-width="5"/><path d="M52 50h24" stroke="#142d32" stroke-width="7" stroke-linecap="round"/><circle cx="54" cy="67" r="4" fill="#142d32"/><circle cx="74" cy="67" r="4" fill="#142d32"/><path d="M15 19h13v-8h14v8h12" fill="none" stroke="#ffb563" stroke-width="5" stroke-linecap="round" stroke-linejoin="round"/></svg>
)WEB";
